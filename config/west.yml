## config/west.yml
```yaml
manifest:
  version: 1.2
  defaults:
    remote: cormoran
    revision: main
  remotes:
    - name: cormoran
      url-base: https://github.com/cormoran
    - name: zmkfirmware
      url-base: https://github.com/zmkfirmware
  projects:
    # ZMK 内核：从官方 v0.3 升级到 cormoran 的 DYA 分支（含 Custom Studio Protocol）
    - name: zmk
      remote: cormoran
      revision: main+dya
      clone-depth: 1
      import:
        file: app/west.yml
    # Zephyr 内核：4.1.0 + cormoran 修复补丁（v0.3 内置 3.x，升级需显式引入）
    - name: zephyr
      remote: cormoran
      revision: v4.1.0+zmk-fixes+nrf-half-duplex-uart
      clone-depth: 1
      import:
        name-blocklist:
          - ci-tools
          - hal_altera
          - hal_cypress
          - hal_infineon
          - hal_microchip
          - hal_nxp
          - hal_openisa
          - hal_xtensa
          - hal_st
          - hal_ti
          - loramac-node
          - mcuboot
          - mcumgr
          - net-tools
          - openthread
          - edtt
          - trusted-firmware-m
          - chre
    # 轨迹球驱动：替换原 DoctorWangWang/zmk-pmw3610-driver，
    # 使用 cormoran 的 drop-in 替代品（compatible = "cormoran,pmw3610"），
    # 自带完整驱动 + Custom Studio RPC（传感器信息/诊断/寄存器访问/帧捕获）。
    - name: zmk-driver-pmw3610-with-custom-studio-rpc
      remote: cormoran
      revision: main
      import: true
    # DYA 功能模块（与 noirix44 对齐）
    - name: zmk-feature-custom-settings
      remote: cormoran
      revision: main
    - name: zmk-feature-device-info
      remote: cormoran
      revision: main
    - name: zmk-feature-runtime-macro
      remote: cormoran
      revision: main
      import: true
    - name: zmk-feature-runtime-combo
      remote: cormoran
      revision: main
      import: true
    - name: zmk-behavior-runtime-sensor-rotate
      remote: cormoran
      revision: main
    - name: zmk-module-ble-management
      remote: cormoran
      revision: main
    - name: zmk-module-battery-history
      remote: cormoran
      revision: main
    - name: zmk-module-settings-rpc
      remote: cormoran
      revision: main
    - name: zmk-module-runtime-input-processor
      remote: cormoran
      revision: main
  self:
    path: config
```

## modules/noirix-auth/Kconfig
```kconfig
# Noirix device identity reporting module.

config NOIRIX_AUTH
    bool "Noirix device identity reporting (device-id whitelist)"
    default y
    depends on ZMK_STUDIO_RPC
    select HWINFO
    help
      Registers the "noirix__auth" ZMK Studio RPC subsystem, which reports the
      MCU unique ID (device_id) so the host (dya-studio) can check it against a
      whitelist of authorized device IDs. No shared secret or MAC is involved;
      the host stores whitelisted device IDs as SHA-256 hashes.

      Depends on CONFIG_ZMK_STUDIO_RPC (the custom RPC subsystem is registered
      via ZMK Studio's custom subsystem API). On a split keyboard only the
      central half enables ZMK_STUDIO_RPC, so this is only built there.
```
