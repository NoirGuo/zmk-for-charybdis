## Kconfig
```kconfig
config ZMK_KEY_STATS
    bool "Track physical key press statistics"
    default n
    depends on SETTINGS
    help
      Count only ZMK physical key position press events. Encoder sensor events and pointing
      input events are intentionally not counted.

config ZMK_KEY_STATS_SAVE_DEBOUNCE_SECONDS
    int "Delay before saving key statistics"
    default 30
    depends on ZMK_KEY_STATS

config ZMK_KEY_STATS_SAVE_PRESS_INTERVAL
    int "Save key statistics every N key presses"
    default 50
    depends on ZMK_KEY_STATS

config ZMK_DONGLE_MONITOR
    bool "Build the display receiver as a BLE status monitor"
    default n
    depends on BT && BT_OBSERVER && ZMK_DISPLAY
    help
      Listen for Prospector-compatible keyboard status advertisements instead
      of acting as the split keyboard central. The OLED theme code is shared
      with the normal dongle build.

config ZMK_DONGLE_MONITOR_CHANNEL
    int "Prospector channel accepted by the monitor"
    range 0 255
    default 0
    depends on ZMK_DONGLE_MONITOR
    help
      Zero accepts every Prospector channel. A non-zero value accepts that
      channel and keyboards broadcasting on channel zero.
```

## boards/shields/dongle_display/Kconfig.defconfig
```kconfig
# Copyright (c) 2024 The ZMK Contributors
# SPDX-License-Identifier: MIT

if SHIELD_DONGLE_DISPLAY

choice ZMK_DISPLAY_STATUS_SCREEN
    default ZMK_DISPLAY_STATUS_SCREEN_CUSTOM
endchoice

config ZMK_DISPLAY_STATUS_SCREEN_CUSTOM
    select LV_USE_LABEL
    select LV_USE_IMAGE
    select LV_USE_CANVAS
    select LV_USE_ANIMIMG 
    select LV_USE_ANIMATION
    select LV_USE_LINE 
    select LV_FONT_MONTSERRAT_12
    select LV_FONT_MONTSERRAT_14
    select LV_FONT_MONTSERRAT_16
    select LV_FONT_MONTSERRAT_20
    select LV_FONT_MONTSERRAT_24
    select ZMK_WPM
    imply ZMK_HID_INDICATORS

config ZMK_DONGLE_DISPLAY_DONGLE_BATTERY
    bool "Show also the battery level of the dongle"
    depends on BT && (!ZMK_SPLIT_BLE || ZMK_SPLIT_ROLE_CENTRAL)

config ZMK_DONGLE_DISPLAY_MAC_MODIFIERS
    bool "Use MacOS modifier symbols instead of the Windows symbols"

config ZMK_DONGLE_DISPLAY_BONGO_CAT
    bool "Display the Bongo Cat widget"
    default y

config ZMK_DONGLE_DISPLAY_MODIFIERS
    bool "Display the modifiers widget"
    default y

config ZMK_DONGLE_DISPLAY_LAYER
    bool "Display the highest layer widget"
    default y

config ZMK_DONGLE_DISPLAY_LAYER_NAME_SCROLL_WIDTH
    int "Width for layer name label (in pixels)"
    default 50
    help
        Width in pixels for the layer name label. When the layer name
        exceeds this width, it will scroll horizontally in a circular pattern.

config ZMK_DONGLE_DISPLAY_LAYER_TEXT_ALIGN
    string "Layer name text alignment"
    default "left"
    help
        Text alignment for the layer name label. Valid values: "left", "center", "right".

config ZMK_DONGLE_DISPLAY_WPM
    bool "Display the WPM widget"
    default n

config ZMK_DONGLE_DISPLAY_WPM_DISABLED_LAYERS
    string "Layers in which the widget is disabled, comma separated"
    default ""

choice ZMK_DISPLAY_WORK_QUEUE
    default ZMK_DISPLAY_WORK_QUEUE_DEDICATED
endchoice

# ST7789V 240x240 RGB565: LVGL must run at 16bpp instead of the 1bpp used
# for the old 128x64 SSD1306. VDB is kept at 64% (~73 KB of a 115 KB full
# frame) as a compromise between RAM usage and refresh throughput.
config LV_Z_MEM_POOL_SIZE
    default 16384

config LV_Z_VDB_SIZE
    default 64

config LV_DPI_DEF
    default 148

config LV_Z_BITS_PER_PIXEL
    default 16

choice LV_COLOR_DEPTH
    default LV_COLOR_DEPTH_16
endchoice

# RGB565 字节序跟随屏幕模组。用户屏与 Sofle Monitor 同款（DZT970525 配置为 n）。
# 若实测红蓝对调，把此值改为 y 即可。
config LV_COLOR_16_SWAP
    default n

endif
```

## boards/shields/monitor_adapter/Kconfig.defconfig
```kconfig
# SPDX-License-Identifier: MIT

if SHIELD_MONITOR_ADAPTER

config ZMK_KEYBOARD_NAME
    default "Charybdis Monitor"

config ZMK_DONGLE_MONITOR
    default y

config ZMK_DISPLAY
    default y

endif
```

## boards/shields/monitor_adapter/Kconfig.shield
```kconfig
# SPDX-License-Identifier: MIT

config SHIELD_MONITOR_ADAPTER
    def_bool $(shields_list_contains,monitor_adapter)
```

## config/west.yml
```yaml
manifest:
  version: 1.2
  defaults:
    remote: cormoran
    revision: main
  remotes:
    - name: cormoran
      url-base: https://github.com/cormoran
    - name: zmkfirmware
      url-base: https://github.com/zmkfirmware
    - name: gpeye
      url-base: https://github.com/GPeye
    - name: tokyo2006
      url-base: https://github.com/tokyo2006
    - name: englmaxi
      url-base: https://github.com/englmaxi
    - name: prospector
      url-base: https://github.com/NoirGuo
  projects:
    - name: mario-peripheral-animation
      remote: gpeye
      revision: main
    - name: zmk
      remote: cormoran
      revision: main+dya
      clone-depth: 1
      import:
        file: app/west.yml
    - name: zephyr
      remote: cormoran
      revision: v4.1.0+zmk-fixes+nrf-half-duplex-uart
      clone-depth: 1
      import:
        name-blocklist:
          - ci-tools
          - hal_altera
          - hal_cypress
          - hal_infineon
          - hal_microchip
          - hal_nxp
          - hal_openisa
          - hal_xtensa
          - hal_st
          - hal_ti
          - loramac-node
          - mcuboot
          - mcumgr
          - net-tools
          - openthread
          - edtt
          - trusted-firmware-m
          - chre
    - name: zmk-feature-custom-settings
      remote: cormoran
      revision: main
    - name: zmk-feature-device-info
      remote: cormoran
      revision: main
    - name: zmk-feature-runtime-macro
      remote: cormoran
      revision: main
      import: true
    - name: zmk-feature-runtime-combo
      remote: cormoran
      revision: main
      import: true
    - name: zmk-behavior-runtime-sensor-rotate
      remote: cormoran
      revision: main
    - name: zmk-module-ble-management
      remote: cormoran
      revision: main
    - name: zmk-module-battery-history
      remote: cormoran
      revision: main
    - name: zmk-module-settings-rpc
      remote: cormoran
      revision: main
    - name: zmk-module-runtime-input-processor
      remote: cormoran
      revision: main
    - name: prospector-zmk-module
      remote: prospector
      revision: OLED
      path: modules/prospector-zmk-module
    # 注：Charybdis 轨迹球 PMW3610 不再使用 DoctorWangWang/zmk-pmw3610-driver
    # （该驱动基于 Zephyr 3.5、2024 年停更，且其 devicetree binding 与
    # Zephyr 4.1 主线自带 pixart,pmw3610 binding 冲突）。
    # Zephyr 4.1 主线已自带 pmw3610 输入驱动（CONFIG_INPUT_PMW3610），
    # 由 devicetree 节点自动启用，配合 zmk,input-listener 桥接 ZMK pointing。
  self:
    path: config
```

## dts/bindings/display/noirix,gc9a01.yaml
```yaml
# Copyright (c) 2019, Marc Reilly <marc@cpdesign.com.au>
# Copyright (c) 2019, PHYTEC Messtechnik GmbH
# Copyright (c) 2026 NoirGuo
# SPDX-License-Identifier: Apache-2.0

description: |
  GC9A01 240x240 circular display controller driven over a raw SPI bus with a
  separate command/data (D/C) GPIO line.

  This is the direct-SPI binding used by the Noirix44 monitor port, modeled on
  the custom "noirix,st7789v" binding (carrefinho/prospector-zmk-module style).
  The Zephyr 4.1 in-tree "galaxycore,gc9x01x" binding uses the MIPI-DBI wrapper
  and requires a mipi-mode property, which is incompatible with the direct-SPI
  node layout used here; hence the custom compatible.

  Panel wiring (8 pins): VCC GND SCL SDA DC CS RST BL. BL is the backlight
  (PWM, wired like the ST7789V monitor: P0.11 / PWM1 OUT0 via "zmk,display-led").

compatible: "noirix,gc9a01"

include: [spi-device.yaml]

properties:
  cmd-data-gpios:
    type: phandle-array
    required: true
    description: |
      Command/Data (D/C) GPIO. High = command, low = data (the driver toggles
      it around each SPI write).

  reset-gpios:
    type: phandle-array
    description: |
      Optional reset GPIO. When present, the driver pulses it at init;
      otherwise it falls back to the GC9A01 software reset command.

  width:
    type: int
    required: true
    description: Display width in pixels (240 for the 1.28" round panel)

  height:
    type: int
    required: true
    description: Display height in pixels (240 for the 1.28" round panel)

  x-offset:
    type: int
    default: 0
    description: Column offset of the visible panel in the controller RAM

  y-offset:
    type: int
    default: 0
    description: Row offset of the visible panel in the controller RAM

  mdac:
    type: int
    required: true
    description: Memory Data Access Control (MADCTL) value. Base value for
      rotation, e.g. 0x08 (BGR) for normal orientation.

  colmod:
    type: int
    required: true
    description: Interface Pixel Format (PIXFMT/COLMOD) value, e.g. 0x55 for
      RGB565 (16-bit MCU + 16-bit RGB).

  display-inversion:
    type: boolean
    description: Send INVON after init (every bit inverted in frame memory).

  pwrctrl1:
    type: uint8-array
    default: [0x00]
    description: Power Control 1 register value

  pwrctrl2:
    type: uint8-array
    default: [0x13]
    description: Power Control 2 register value

  pwrctrl3:
    type: uint8-array
    default: [0x13]
    description: Power Control 3 register value

  pwrctrl4:
    type: uint8-array
    default: [0x22]
    description: Power Control 4 register value

  gamma1:
    type: uint8-array
    default: [0x45, 0x09, 0x08, 0x08, 0x26, 0x2A]
    description: Gamma correction 1 register values (negative polarity)

  gamma2:
    type: uint8-array
    default: [0x43, 0x70, 0x72, 0x36, 0x37, 0x6F]
    description: Gamma correction 2 register values

  gamma3:
    type: uint8-array
    default: [0x45, 0x09, 0x08, 0x08, 0x26, 0x2A]
    description: Gamma correction 3 register values (positive polarity)

  gamma4:
    type: uint8-array
    default: [0x43, 0x70, 0x72, 0x36, 0x37, 0x6F]
    description: Gamma correction 4 register values

  framerate:
    type: uint8-array
    default: [0x34]
    description: Frame rate register value
```
